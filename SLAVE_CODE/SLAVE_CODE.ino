#include <PCM.h>
#include <Wire.h>
#include <SoftwareSerial.h>
#define ARDUINO_RX 4//should connect to TX of the Serial MP3 Player module
#define ARDUINO_TX 3//connect to RX of the module
SoftwareSerial myMP3(ARDUINO_RX, ARDUINO_TX);



bool start0=false;
bool start1=false;
bool start2=false;
int PressurePin0=A0;
int PressurePin1=A1;
int PressurePin2=A2;
int force0;
int force1;
int force2;
unsigned long time;

bool playstart = false;

volatile byte myData[3];
volatile bool flag = false;

const unsigned char sound1[] PROGMEM = {
  126, 127, 128, 127, 127, 127, 128, 127, 127, 128, 128, 127,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 129, 

 };
const unsigned char sound2[] PROGMEM = {
  129, 127, 127, 128, 127, 127, 128, 127, 127, 128, 128, 127,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 110, 
  
  };

const unsigned char sound3[] PROGMEM = {
  129, 127, 128, 128, 127, 128, 127, 127, 127, 128, 128, 126,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 136, 
 };


void setup() {

  // Start the I2C Bus as Slave on address 9
  Wire.begin(9); 
  // Attach a function to trigger when something is received.
  Wire.onReceive(receiveEvent);

  Serial.begin(9600);
  delay(500);

  myMP3.write(0x7E); //start of instruction
  myMP3.write(0x03); //number of bytes excluding start and end byte
  myMP3.write(0x35);  //Command
  myMP3.write(0x01);  //data..usually 1 byte
  myMP3.write(0xEF);  //end byte
  delay(20);
}

void loop() {

  time = millis();
  Serial.println(time);
  if(time > 60000 || !playstart )
  { 
    playstart = true;
    Serial.println("Play sound 1");
    //Now lets Play the first song 7E 04 41 00 01 EF
    myMP3.write(0x7E);  //start of instruction
    myMP3.write(0x04);  //number of bytes excluding start and end byte
    myMP3.write(0x41);  //command
    //next line is the first byte of data 0x00 will mean file is in root directory
    myMP3.write((byte)0x00);//forces the value to be read as a byte, otherwise error occurs
    myMP3.write(0x02);//will be the first file on the card
    myMP3.write(0xEF); //end byte
  }
    
  
  if(myData[2]==1)
  {                                                                                 //sound 1 condition
    startPlayback(sound3, sizeof(sound3));
    Serial.println("force3");
  }
  
  else if(myData[1]==1)
  {                                                                                 //sound 2 condition
    startPlayback(sound2, sizeof(sound2));
    Serial.println("force2");
  }
  
  else if(myData[0]==1){                                                                                 //sound 3 condition
  
    startPlayback(sound1, sizeof(sound1));
    Serial.println("force3");
  }  
}

void receiveEvent(int bytes) {
  for (int i = 0; i < bytes; i++)
  {
    myData[i] = Wire.read();
  }
}
